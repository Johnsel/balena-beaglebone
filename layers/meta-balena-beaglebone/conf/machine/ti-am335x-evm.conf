## layers/meta-balena-beaglebone/conf/machine/ti-am335x-evm.conf
```bitbake
#@TYPE: Machine
#@NAME: BeagleBoard-XM
#@DESCRIPTION: Machine configuration for the BeagleBoard-XM

MACHINEOVERRIDES = "ti-am335x-evm:${MACHINE}"

include conf/machine/am335x-evm.conf
```
